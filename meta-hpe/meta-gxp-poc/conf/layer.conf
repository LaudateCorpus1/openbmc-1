## meta-hpe/meta-gxp-poc/conf/layer.conf
```bitbake
# We have a conf and classes directory, add to BBPATH
BBPATH .= ":${LAYERDIR}"

# We have recipes-* directories, add to BBFILES
BBFILES += "${LAYERDIR}/recipes-*/*/*.bb \
            ${LAYERDIR}/recipes-*/*/*.bbappend"

BBFILE_COLLECTIONS += "meta-gxp-poc"
BBFILE_PATTERN_meta-gxp-poc = "^${LAYERDIR}/"
BBFILE_PRIORITY_meta-gxp-poc = "6"

LAYERDEPENDS_meta-gxp-poc = "core"
LAYERSERIES_COMPAT_meta-gxp-poc = "gatesgarth"
```

## meta-hpe/meta-xl225n-g10p/conf/layer.conf
```bitbake
# We have a conf and classes directory, add to BBPATH
BBPATH .= ":${LAYERDIR}"

# We have recipes-* directories, add to BBFILES
BBFILES += "${LAYERDIR}/recipes-*/*/*.bb \
            ${LAYERDIR}/recipes-*/*/*.bbappend"

BBFILE_COLLECTIONS += "xl225n-g10p-layer"
BBFILE_PATTERN_xl225n-g10p-layer := "^${LAYERDIR}/"
LAYERSERIES_COMPAT_xl225n-g10p-layer = "zeus warrior dunfell"
```

## meta-hpe/meta-xl225n-g10p/conf/machine/xl225n-g10p.conf
```bitbake
KERNEL_DEVICETREE = "gxp.dtb"

require conf/machine/include/gxp.inc
require conf/machine/include/obmc-bsp-common.inc
require conf/machine/include/hpe.inc

PREFERRED_PROVIDER_virtual/phosphor-led-manager-config-native = "hpe-g10p-common-led-manager-config-native"

VIRTUAL-RUNTIME_obmc-fan-control ?= "phosphor-pid-control"
```
